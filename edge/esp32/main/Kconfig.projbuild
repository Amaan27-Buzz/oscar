## edge/esp32/main/Kconfig.projbuild
```kconfig
menu "OSCAR Edge test profile"
config OSCAR_EDGE_WATCHDOG_TEST
    bool "Owner watchdog fault test on GPIO27 (not production)"
    default n
endmenu
```

## edge/esp32/sdkconfig.defaults
```kconfig
CONFIG_ESP_TASK_WDT_EN=y
CONFIG_ESP_TASK_WDT_INIT=y
CONFIG_ESP_TASK_WDT_PANIC=y
CONFIG_ESP_TASK_WDT_TIMEOUT_S=5
CONFIG_ESP_INT_WDT=y
CONFIG_ESP_HTTP_CLIENT_ENABLE_HTTPS=y
```
